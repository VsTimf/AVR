
#include "lcd_lh155ba.h"
#include <string.h>
#include <avr/pgmspace.h>


LCD_T lcd;


static const unsigned char  _LCD1_1_FONT[32][8] PROGMEM =                     /* the default 8x8 font a mix of Times and Souvenier named LCD1*/
{
      { 0x00, 0x00, 0x00, 0x00, 0x00, 0x00, 0x00, 0x00 },	// char 32: space
      { 0x18, 0x3C, 0x3C, 0x18, 0x18, 0x00, 0x18, 0x00 },
      { 0x6C, 0x6C, 0x6C, 0x00, 0x00, 0x00, 0x00, 0x00 },
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      { 0x3C, 0x66, 0x0C, 0x18, 0x18, 0x00, 0x18, 0x00 },
};

static const unsigned char  _LCD1_2_FONT[32][8] PROGMEM = 
{
      { 0x7C, 0xC6, 0xDE, 0xDE, 0xDC, 0xC0, 0x7C, 0x00 },
      { 0x30, 0x78, 0xCC, 0xCC, 0xFC, 0xCC, 0xCC, 0x00 },
      { 0xFC, 0x66, 0x66, 0x7C, 0x66, 0x66, 0xFC, 0x00 },
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      { 0x00, 0x00, 0x00, 0x00, 0x00, 0x00, 0x00, 0xFF },
};

static const unsigned char  _LCD1_3_FONT[32][8] PROGMEM = 
{
      { 0x30, 0x30, 0x18, 0x00, 0x00, 0x00, 0x00, 0x00 },
      { 0x00, 0x00, 0x78, 0x0C, 0x7C, 0xCC, 0x76, 0x00 },
      { 0xE0, 0x60, 0x60, 0x7C, 0x66, 0x66, 0xDC, 0x00 },
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      { 0x00, 0x10, 0x38, 0x6C, 0xC6, 0xC6, 0xFE, 0x00 },
};

static const unsigned char  _LCD1_4_FONT[32][8] PROGMEM = 
{
      { 0x00, 0x10, 0x38, 0x6C, 0xC6, 0xC6, 0xFE, 0x00 },
      { 0x00, 0x10, 0x38, 0x6C, 0xC6, 0xC6, 0xFE, 0x00 },
      { 0x00, 0x10, 0x38, 0x6C, 0xC6, 0xC6, 0xFE, 0x00 },
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      { 0x00, 0x10, 0x38, 0x6C, 0xC6, 0xC6, 0xFE, 0x00 },
};

static const unsigned char  _LCD1_5_FONT[32][8] PROGMEM = 
{
      { 0x00, 0x10, 0x38, 0x6C, 0xC6, 0xC6, 0xFE, 0x00 },
      { 0x18, 0x18, 0x00, 0x18, 0x18, 0x18, 0x18, 0x00 },
      { 0x18, 0x18, 0x7E, 0xC0, 0xC0, 0x7E, 0x18, 0x18 },
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      { 0x30, 0x00, 0x30, 0x60, 0xC0, 0xCC, 0x78, 0x00 },
};

static const unsigned char  _LCD1_6_FONT[32][8] PROGMEM = 
{
      { 0x18, 0x0C, 0x38, 0x6C, 0xC6, 0xFE, 0xC6, 0x00 },
      { 0x30, 0x60, 0x38, 0x6C, 0xC6, 0xFE, 0xC6, 0x00 },
      { 0x7C, 0x82, 0x38, 0x6C, 0xC6, 0xFE, 0xC6, 0x00 },
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      { 0x78, 0xCC, 0xCC, 0xD8, 0xCC, 0xC6, 0xCC, 0x00 },
};

static const unsigned char  _LCD1_7_FONT[32][8] PROGMEM = 
{
      { 0xE0, 0x00, 0x78, 0x0C, 0x7C, 0xCC, 0x7E, 0x00 },
      { 0x1C, 0x00, 0x78, 0x0C, 0x7C, 0xCC, 0x7E, 0x00 },
      { 0x7E, 0xC3, 0x3C, 0x06, 0x3E, 0x66, 0x3F, 0x00 },
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      { 0x00, 0xCC, 0x00, 0xCC, 0xCC, 0x7C, 0x0C, 0xF8 }
};

/*
 static const unsigned char  font_2x[25][16] PROGMEM = {
 	{0x3f,0xf0, 0xf0,0xfc, 0xf3,0xfc, 0xff,0x3c, 0xfc,0x3c, 0xf0,0x3c, 0x3f,0xf0, 0x00,0x00, },	//0
 	{0x0f,0x00, 0x3f,0x00, 0x0f,0x00, 0x0f,0x00, 0x0f,0x00, 0x0f,0x00, 0xff,0xf0, 0x00,0x00, }, //1		
 	{0x3f,0xc0, 0xf0,0xf0, 0x00,0xf0, 0x0f,0xc0, 0x3c,0x00, 0xf0,0xf0, 0xff,0xf0, 0x00,0x00, }, //2
 	
 	{0x3f,0xc0, 0xf0,0xf0, 0x00,0xf0, 0x0f,0xc0, 0x00,0xf0, 0xf0,0xf0, 0x3f,0xc0, 0x00,0x00, }, //3
 	{0x03,0xf0, 0x0f,0xf0, 0x3c,0xf0, 0xf0,0xf0, 0xff,0xfc, 0x00,0xf0, 0x03,0xfc, 0x00,0x00, }, //4
 	{0xff,0xf0, 0xf0,0x00, 0xff,0xc0, 0x00,0xf0, 0x00,0xf0, 0xf0,0xf0, 0x3f,0xc0, 0x00,0x00, }, //5
 	
 	{0x0f,0xc0, 0x3c,0x00, 0xf0,0x00, 0xff,0xc0, 0xf0,0xf0, 0xf0,0xf0, 0x3f,0xc0, 0x00,0x00, }, //6
 	{0xff,0xf0, 0x00,0xf0, 0x00,0xf0, 0x03,0xc0, 0x03,0xc0, 0x0f,0x00, 0x0f,0x00, 0x00,0x00, }, //7
 	{0x3f,0xc0, 0xf0,0xf0, 0xf0,0xf0, 0x3f,0xc0, 0xf0,0xf0, 0xf0,0xf0, 0x3f,0xc0, 0x00,0x00, }, //8
 	
 		
 	{0x3f,0xc0, 0xf0,0xf0, 0xf0,0xf0, 0x3f,0xf0, 0x00,0x78, 0x01,0xe0, 0x1f,0x80, 0x00,0x00, }, //9
 	{0x00,0x00, 0x00,0x00, 0xcc,0xc0, 0xf3,0x3c, 0xf3,0x3c, 0xf3,0x3c, 0xf3,0x3c, 0x00,0x00, }, //m
 	{0x00,0x00, 0x00,0x00, 0x3f,0xc0, 0x00,0xf0, 0x3f,0xf0, 0xf0,0xf0, 0x3f,0x3c, 0x00,0x00, }, //a
 	
 	{0x00,0x00, 0x00,0x00, 0xcf,0xc0, 0xf0,0xf0, 0xf0,0xf0, 0xf0,0xf0, 0xf0,0xf0, 0x00,0x00, }, //n
 	{0x00,0x00, 0x00,0x00, 0xf0,0xf0, 0xf0,0xf0, 0xf0,0xf0, 0xf0,0xf0, 0x3f,0x3c, 0x00,0x00, }, //u
 	{0xfc,0x00, 0x3c,0x00, 0x3c,0x00, 0x3c,0x00, 0x3c,0x00, 0x3c,0x00, 0xff,0x00, 0x00,0x00, }, //l
 		
 	{0x00,0x00, 0x00,0x00, 0x3f,0xe0, 0xf0,0x00, 0x3f,0x00, 0x03,0xe0, 0xff,0x80, 0x00,0x00, }, //s
 	{0x00,0x00, 0x00,0x00, 0x00,0x00, 0x00,0x00, 0x00,0x00, 0x3c,0x00, 0x3c,0x00, 0xf0,0x00, }, //,
 	{0x00,0x00, 0x00,0x00, 0x00,0x00, 0x00,0x00, 0x00,0x00, 0x00,0x00, 0x00,0x00, 0x00,0x00, }, //
 		
 		
 	{0xff,0xf0, 0x0f,0x00, 0x0f,0x00, 0x0f,0x00, 0x0f,0x00, 0x0f,0x00, 0x0f,0x00, 0x00,0x00, }, //t
 	{0xff,0x00, 0xf0,0xf0, 0xf0,0xf0, 0xff,0x00, 0xf0,0x00, 0xf0,0x00, 0xf0,0x00, 0x00,0x00, },	//p
 	{0x00,0x00, 0x00,0x00, 0x00,0x00, 0xff,0xf0, 0x00,0x00, 0xff,0xf0, 0x00,0x00, 0x00,0x00, },	//=
 		
 	
 	{0x00,0x00, 0x00,0x3c, 0x03,0xc3, 0x0c,0x33, 0x33,0xc3, 0x33,0x33, 0x0c,0xf3, 0x03,0xc3, }, //w left topboom
 	{0x00,0x00, 0x3c,0x00, 0xc3,0xc0, 0xcc,0x30, 0xc3,0xcc, 0xcc,0xcc, 0xcf,0x30, 0xc3,0xc0, }, //w right topboom	
 	{0x00,0x03, 0x00,0x03, 0x00,0x03, 0x00,0x03, 0x00,0x03, 0x00,0xc3, 0x0c,0xcf, 0x3f,0xff, }, //q left botboom	
 	{0xc0,0x00, 0xc0,0x00, 0xc0,0x00, 0xc0,0x00, 0xc0,0x00, 0xc3,0x00, 0xf3,0x30, 0xff,0xfc, }, //q right botboom	
 	
 	//{0x00,0x00, 0x06,0x60, 0x19,0x98, 0x25,0xa4, 0x59,0x9a, 0x55,0xaa, 0x2d,0xb4, 0x19,0x98, }, //q topboom
 	//{0x01,0x80, 0x01,0x80, 0x01,0x80, 0x01,0x80, 0x01,0x80, 0x09,0x90, 0x2b,0xd4, 0x7f,0xfe, },	//w bottomboom
 };
*/


/* Handle for big font created in DotFactory-RLE 
1. symbol width in bytes
2. symbol height in pixels
3. symbol weight in bytes 
*/
static const uint8_t Bitmap_h[] = {3, 32, 96};

/* Character bitmaps for big font created in DotFactory-RLE */
static const unsigned char Bitmaps[] PROGMEM =
{
	/* @0 '0' (21 pixels wide) */
	0x00, 0x7C, 0x00, //   ---------#####-------
	0x01, 0xC6, 0x00, //   -------###---##------
	0x03, 0x83, 0x00, //   ------###-----##-----
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	0x00, 0xF8, 0x00, //   --------#####--------

	/* @96 '1' (21 pixels wide) */
	0x00, 0x18, 0x00, //   -----------##--------
	0x00, 0x78, 0x00, //   ---------####--------
	0x01, 0xF8, 0x00, //   -------######--------
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	0x07, 0xFF, 0x80, //   -----############----

	/* @192 '2' (21 pixels wide) */
	0x01, 0xF8, 0x00, //   -------######--------
	0x07, 0xFE, 0x00, //   -----##########------
	0x0F, 0xFF, 0x80, //   ----#############----
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	0xFF, 0xFF, 0xE0, //   ###################--

	/* @288 '3' (21 pixels wide) */
	0x01, 0xF8, 0x00, //   -------######--------
	0x07, 0xFE, 0x00, //   -----##########------
	0x0F, 0xFF, 0x00, //   ----############-----
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	0x1F, 0xE0, 0x00, //   ---########----------

	/* @384 '4' (21 pixels wide) */
	0x00, 0x03, 0x80, //   --------------###----
	0x00, 0x07, 0x80, //   -------------####----
	0x00, 0x07, 0x80, //   -------------####----
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	0x00, 0x07, 0x80, //   -------------####----

	/* @480 '5' (21 pixels wide) */
	0x00, 0xFF, 0xF0, //   --------############-
	0x01, 0xFF, 0xE0, //   -------############--
	0x01, 0xFF, 0xE0, //   -------############--
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	0x1F, 0xC0, 0x00, //   ---#######-----------

	/* @576 '6' (21 pixels wide) */
	0x00, 0x01, 0xF0, //   ---------------#####-
	0x00, 0x0F, 0x80, //   ------------#####----
	0x00, 0x3E, 0x00, //   ----------#####------
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	0x00, 0xFC, 0x00, //   --------######-------

	/* @672 '7' (21 pixels wide) */
	0x0F, 0xFF, 0xF8, //   ----#################
	0x1F, 0xFF, 0xF8, //   ---##################
	0x1F, 0xFF, 0xF0, //   ---#################-
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	0x00, 0x60, 0x00, //   ---------##----------

	/* @768 '8' (21 pixels wide) */
	0x00, 0xFC, 0x00, //   --------######-------
	0x03, 0x83, 0x00, //   ------###-----##-----
	0x06, 0x01, 0x80, //   -----##--------##----
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	0x01, 0xFC, 0x00, //   -------#######-------

	/* @864 '9' (21 pixels wide) */
	0x00, 0xFC, 0x00, //   --------######-------
	0x03, 0x8F, 0x00, //   ------###---####-----
	0x07, 0x07, 0x80, //   -----###-----####----
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	0x3E, 0x00, 0x00, //   --#####--------------
};








void LCD_write_data(unsigned char c)
{
	unsigned char __c2;
	
	LCDPORT &= ~(SCL);
	__c2 =c;

	LCDPORT &= ~(RS);// its data

	// transmit byte from highest bit to lowest bit
	for (unsigned char i=0; i<8; i++)
	{
		LCDPORT &= ~(SCL);
		if ( (__c2 & 128)==0 )
		LCDPORT &= ~(SDA);
		else
		LCDPORT |=(SDA);
		__c2=__c2<<1;
		_delay_us(WDELAY);
		LCDPORT |=(SCL);// when SCL goes high data on PIN SID are accepted by controller
		_delay_us(WDELAY);
	}
	LCDPORT &= ~(SCL); 	// prepare for next byte
	LCDPORT &= ~(SDA);
}




void LCD_put_digit(uint8_t dig)
{
	unsigned pos = 0;
	uint8_t _ypos = lcd.y_pos;

	if(dig > 9) return;
	
	pos = dig * Bitmap_h[2];
	
	LCD_write_byte(0b10100001,1); 	//increment control register; increment x+y=0011 increment x=0001; increment y = 0010				 Incerment control set
	

	for (uint8_t ypos=0; ypos < Bitmap_h[1]; ypos++)
	{
		for (uint8_t xpos=0; xpos < Bitmap_h[0]; xpos++)
			LCD_write_data(pgm_read_byte(&(Bitmaps[pos++])));
		
		LCD_x_pos(lcd.x_pos);
		LCD_y_pos(lcd.y_pos+1);
	}
		
	LCD_write_byte(0b10100010,1); 	//increment control register; increment x+y=0011 increment x=0001; increment y = 0010				 Incerment control set
	
	LCD_x_pos(lcd.x_pos + Bitmap_h[0]);
	LCD_y_pos(_ypos);
}





// data: data_command = 0
// command: data_command = 1
// clear_sreen: data_command = 3
void LCD_write_byte(unsigned char c, int data_command)
{
	unsigned char __c2;
	
  	LCDPORT &= ~(SCL);
	__c2 =c;

	if (data_command == 1)
		LCDPORT |=(RS);// its command 
	else
		LCDPORT &= ~(RS);// its data

	// transmit byte from highest bit to lowest bit
	for (unsigned char i=0; i<8; i++)
	{
		LCDPORT &= ~(SCL);
		if ( (__c2 & 128)==0 )
			LCDPORT &= ~(SDA);
		else
			LCDPORT |=(SDA);
		__c2=__c2<<1;
		_delay_us(WDELAY);
		LCDPORT |=(SCL);// when SCL goes high data on PIN SID are accepted by controller
		_delay_us(WDELAY);
	}	
	LCDPORT &= ~(SCL); 	// prepare for next byte
   	LCDPORT &= ~(SDA);
	   
	// set new x and y coordinates if DATA (not command nor clear screen
	if (data_command == 0)
	{ 
		if (lcd.y_pos<LCD_Y_MAX)
			lcd.y_pos++;
		else
			lcd.y_pos=0; // increment loop 
	}
}



/////////////////////////////////////////////////////////////////////////////////////////////////////
// Init Display, power it on etc.
void LCD_init()
{
	LCDPORT &= ~(RES);		// Reset
	LCDPORT &= ~(SCL);
	LCDPORT &= ~(SDA);		
	LCDPORT &= ~(RS);		// 0 - Data to RAM    1 - command
	
	_delay_ms(10); // wait for power to stabilize
	
	LCDPORT |=(RES);
	
	_delay_ms(1);
	
   	LCD_write_byte(0b10110001,1);  // power control register	Reset  
	   
   	_delay_ms(1);
	   
   	LCD_write_byte(0b10110010,1);  // power control register   Power ON
   	LCD_write_byte(0b10000001,1);  // display control register	Display ON
	   
   	_delay_ms(1);
	   
	// ***********************************************************************+
	// This is very important: set contrast
	// Thanks to J.Sturz and T.Winkler from TI
	
   	LCD_write_byte(0b11011100,1);	// contrast level VERY low 10 = 1010 contrast level high 13=1101
   	LCD_write_byte(0b10010011,1);		// Display swap lets X begin in upper left corner // default is upper left corner  SWAP, REF     Display control 2
  	LCD_write_byte(0b10100010,1); 	//increment control register; increment x+y=0011 increment x=0001; increment y = 0010				 Incerment control set
	
}

/* To reduce energy use functions below */
void LCD_ON()
{
   	LCD_write_byte(0b10110010,1);  // power control register   Power ON
   	LCD_write_byte(0b10000001,1);  // display control register	Display ON
}


void LCD_OFF()
{
	LCD_write_byte(0b10000000,1);  // display control register	Display OFF
	LCD_write_byte(0b10110000,1);  // power control register   Power OFF
}

/////////////////////////////////////////////////////////////////////////////////////////////////////
// Position set routines: LCD_pos_0, LCD_y_pos, LCD_x_pos, LCD_xy_pos
// x position corresponds to each 8 pixels (0 - 0, 1- 16, 2 - 24, ..)
// y position corresponds to each pixel 


//set to upper left corner
void LCD_pos_0()
{
   	LCD_write_byte(0b00000000,1); // x = 0
   	LCD_write_byte(0b00100000,1); // y a0, a1,a2, a3 = 0
   	LCD_write_byte(0b00110000,1); // y a6,a5,a4
	lcd.x_pos = 0;
	lcd.y_pos = 0;
}

void LCD_y_pos(unsigned char y)
{ 
	unsigned char myy;
	
	if ((y<0)||(y>LCD_Y_MAX)) 
		return;
	
	lcd.y_pos = y;
  	myy = 0b00100000 + (0b00001111 & y); // low 4 bits
  	LCD_write_byte(myy, 1);

  	myy = 0b01110000 & y; // high 3 bits

	myy >>= 4;
  	myy = myy  + 0b00110000;
  	LCD_write_byte(myy, 1);
}

void LCD_x_pos(unsigned char x)
{
	if ((x<0)||(x>LCD_X_MAX)) 
		return;
	
	lcd.x_pos = x;
  	LCD_write_byte(0b00001111 & x,1);
}


void LCD_xy_pos(uint8_t x, uint8_t y)
{
	unsigned char myy;
	
	if ((x<0)||(x>LCD_X_MAX)) 
		return;
		
	if ((y<0)||(y>LCD_Y_MAX)) 
		return;
	
	lcd.x_pos = x;
	LCD_write_byte(0b00001111 & x,1);
	
	lcd.y_pos = y;
	myy = 0b00100000 + (0b00001111 & y); // low 4 bits
	LCD_write_byte(myy, 1);

	myy = 0b01110000 & y; // high 3 bits

	myy >>= 4;
	myy = myy  + 0b00110000;
	LCD_write_byte(myy, 1);
}


/////////////////////////////////////////////////////////////////////////////////////////////////////
void LCD_clear_display()
{  
	long i;

	// pos = 0
  	LCD_write_byte(0b00000000,1); // x = 0
   	LCD_write_byte(0b00100000,1); // y a0, a1,a2, a3 = 0
   	LCD_write_byte(0b00110000,1); // y a6,a5,a4

	LCD_write_byte(0b10100011,1); //increment control register; increment x+y=0011
			     // increment x=0001
	for (i=0; i<(LCD_X_MAX+1)*(LCD_Y_MAX+1); i++)
		LCD_write_byte(0,3);
        
	LCD_write_byte(0b10100010,1); 	//increment control register; increment x+y=0011
			     		// increment y=0010
	// pos = 0
  	LCD_write_byte(0b00000000,1); // x = 0
   	LCD_write_byte(0b00100000,1); // y a0, a1,a2, a3 = 0
   	LCD_write_byte(0b00110000,1); // y a6,a5,a4
	   
	lcd.x_pos = 0;
	lcd.y_pos = 0;   
}



// void LcdImage ( const byte *imageData )
// {
//     // Оптимизация от Jakub Lasinski (March 14 2009)
//     memcpy_P( LcdCache, imageData, LCD_CACHE_SIZE );  // Тоже самое что и выше, но занимает меньше памяти и быстрее выполняется
//     
//     // Сброс указателей границ в максимальное значение
//     LoWaterMark = 0;
//     HiWaterMark = LCD_CACHE_SIZE - 1;
// 
//     // Установка флага изменений кэша
//     UpdateLcd = TRUE;
// }

// void LCD_putc(char c)
// { unsigned char i,ii,y;
// 
//   if (c=='\n') 			// line feed
// 	{ LCD_x_pos(0); 
// 	  if (lcd.y_pos+9 < LCD_Y_MAX) LCD_y_pos(lcd.y_pos +8);
//  	  else LCD_y_pos (0);
// 	  return; 
// 	}
//   if ((c<32)||(c>223)) return;
//   ii = (c-32) % 32;
//   y = lcd.y_pos;
//   
//  for (i=0; i<8; i++) 
//   {
//     switch ((c-32)/32) {
// 	case 0: LCD_write_byte(_LCD1_1_FONT[ii].b[i],0); break;
// 	case 1: LCD_write_byte(_LCD1_2_FONT[ii].b[i],0);break;
// 	case 2: LCD_write_byte(_LCD1_3_FONT[ii].b[i],0);break;
// 	case 3: LCD_write_byte(_LCD1_4_FONT[ii].b[i],0);break;
// 	case 4: LCD_write_byte(_LCD1_5_FONT[ii].b[i],0);break;
// 	case 5: LCD_write_byte(_LCD1_6_FONT[ii].b[i],0);break;
// 	case 6: LCD_write_byte(_LCD1_7_FONT[ii].b[i],0);break;
// 	}
//    }
//   if (lcd.x_pos<LCD_X_MAX) { LCD_y_pos(y); LCD_x_pos(lcd.x_pos+1);}
//   else {
// 	  if (lcd.y_pos==0) // right downmost position !
// 		{ LCD_pos_0(); }
// 	  else // line feed
// 		{ LCD_x_pos(0); }
// 	}
// }




void LCD_putc(char c)
{ 
	unsigned char i,ii, y;

	if (c=='\n') 			// line feed
	{ 
		LCD_x_pos(0); 
		
		if (lcd.y_pos+9 < LCD_Y_MAX)
			LCD_y_pos(lcd.y_pos + 8);
 		else
			LCD_y_pos (0);
		return; 
	}	

	if ((c<32)||(c>223)) return;
	ii = (c-32) % 32;
	y = lcd.y_pos;
	
	for (i=0; i<8; i++) 
	{
		switch ((c-32)/32)
		{
			case 0:
				LCD_write_byte(pgm_read_byte(&(_LCD1_1_FONT[ii][i])),0);
				break;
			
			case 1:
				LCD_write_byte(pgm_read_byte(&(_LCD1_2_FONT[ii][i])),0);
				break;
			
			case 2:
				LCD_write_byte(pgm_read_byte(&(_LCD1_3_FONT[ii][i])),0);
				break;
			
			case 3:
				LCD_write_byte(pgm_read_byte(&(_LCD1_4_FONT[ii][i])),0);
				break;
		}
	}
	
	if (lcd.x_pos<LCD_X_MAX)
	{
		LCD_y_pos(y);
		LCD_x_pos(lcd.x_pos+1);
	}
	else
	{
		if (lcd.y_pos==0) // right downmost position !
			LCD_pos_0();
		else // line feed
			LCD_x_pos(0);
	}
}

void LCD_printf(char* str)
{
	unsigned int i,Len = strlen(str);
	
	for(i = 0; i<Len; i++)
		LCD_putc(str[i]);
}


/* void LCD_print_2x(uint8_t number) {
	 uint8_t i=0;
	 for (i=0;i<8;i++) {
		 LCD_write_byte(pgm_read_byte(&(font_2x[number][2*i])),0);
		 LCD_write_byte(pgm_read_byte(&(font_2x[number][2*i])),0);
	 }
	 LCD_y_pos(lcd.y_pos);
	 LCD_x_pos(lcd.x_pos+1);
	 for (i=0;i<8;i++) {
		 LCD_write_byte(pgm_read_byte(&(font_2x[number][2*i+1])),0);
		 LCD_write_byte(pgm_read_byte(&(font_2x[number][2*i+1])),0);
	 }
 }


 void lcd_put2xc(char c)
 { 
 	unsigned char i,ii,y;
 	if (c=='\n') 			// line feed
 	{ LCD_x_pos(0); 
 	  if (lcd.y_pos+9 < LCD_Y_MAX)
 		LCD_y_pos(lcd.y_pos + 8);
  	  else
 		LCD_y_pos (0);
 	  return; 
 	}
 	//c = hex[lcd.y_pos & 0x0f];
 	if ((c<32)||(c>223)) return;
 	ii = (c-32) % 32;
 	y = lcd.y_pos;
 	
 	uint8_t z = c - '0';
 	
 	if (z<10) {
 		for (i=0;i<8;i++) {
 			LCD_write_byte(pgm_read_byte(&(font_2x[z][2*i])),0);
 			LCD_write_byte(pgm_read_byte(&(font_2x[z][2*i])),0);
 		}
 		LCD_y_pos(y); 
 		LCD_x_pos(lcd.x_pos+1);
 		for (i=0;i<8;i++) {
 			LCD_write_byte(pgm_read_byte(&(font_2x[z][2*i+1])),0);
 			LCD_write_byte(pgm_read_byte(&(font_2x[z][2*i+1])),0);
 		}
 		
 	}
 	else
 	{
 		if (c == 'm')
 		{
 			for (i=0;i<8;i++) {
 				LCD_write_byte(pgm_read_byte(&(font_2x[10][2*i])),0);
 				LCD_write_byte(pgm_read_byte(&(font_2x[10][2*i])),0);
 			}
 			LCD_y_pos(y); 
 			LCD_x_pos(lcd.x_pos+1);
 			for (i=0;i<8;i++) {
 				LCD_write_byte(pgm_read_byte(&(font_2x[10][2*i+1])),0);
 				LCD_write_byte(pgm_read_byte(&(font_2x[10][2*i+1])),0);
 			}
 		}
 		
 		if (c == 'a')
 		{
 			for (i=0;i<8;i++) {
 				LCD_write_byte(pgm_read_byte(&(font_2x[11][2*i])),0);
 				LCD_write_byte(pgm_read_byte(&(font_2x[11][2*i])),0);
 			}
 			LCD_y_pos(y); 
 			LCD_x_pos(lcd.x_pos+1);
 			for (i=0;i<8;i++) {
 				LCD_write_byte(pgm_read_byte(&(font_2x[11][2*i+1])),0);
 				LCD_write_byte(pgm_read_byte(&(font_2x[11][2*i+1])),0);
 			}
 		}
 		
 		if (c == 'n')
 		{
 			for (i=0;i<8;i++) {
 				LCD_write_byte(pgm_read_byte(&(font_2x[12][2*i])),0);
 				LCD_write_byte(pgm_read_byte(&(font_2x[12][2*i])),0);
 			}
 			LCD_y_pos(y); 
 			LCD_x_pos(lcd.x_pos+1);
 			for (i=0;i<8;i++) {
 				LCD_write_byte(pgm_read_byte(&(font_2x[12][2*i+1])),0);
 				LCD_write_byte(pgm_read_byte(&(font_2x[12][2*i+1])),0);
 			}
 		}
 		
 		if (c == 'u')
 		{
 			for (i=0;i<8;i++) {
 				LCD_write_byte(pgm_read_byte(&(font_2x[13][2*i])),0);
 				LCD_write_byte(pgm_read_byte(&(font_2x[13][2*i])),0);
 			}
 			LCD_y_pos(y); 
 			LCD_x_pos(lcd.x_pos+1);
 			for (i=0;i<8;i++) {
 				LCD_write_byte(pgm_read_byte(&(font_2x[13][2*i+1])),0);
 				LCD_write_byte(pgm_read_byte(&(font_2x[13][2*i+1])),0);
 			}
 		}
 		
 		if (c == 'l')
 		{
 			for (i=0;i<8;i++) {
 				LCD_write_byte(pgm_read_byte(&(font_2x[14][2*i])),0);
 				LCD_write_byte(pgm_read_byte(&(font_2x[14][2*i])),0);
 			}
 			LCD_y_pos(y); 
 			LCD_x_pos(lcd.x_pos+1);
 			for (i=0;i<8;i++) {
 				LCD_write_byte(pgm_read_byte(&(font_2x[14][2*i+1])),0);
 				LCD_write_byte(pgm_read_byte(&(font_2x[14][2*i+1])),0);
 			}
 		}
 		
 		if (c == 's')
 		{
 			for (i=0;i<8;i++) {
 				LCD_write_byte(pgm_read_byte(&(font_2x[15][2*i])),0);
 				LCD_write_byte(pgm_read_byte(&(font_2x[15][2*i])),0);
 			}
 			LCD_y_pos(y); 
 			LCD_x_pos(lcd.x_pos+1);
 			for (i=0;i<8;i++) {
 				LCD_write_byte(pgm_read_byte(&(font_2x[15][2*i+1])),0);
 				LCD_write_byte(pgm_read_byte(&(font_2x[15][2*i+1])),0);
 			}
 		}
 		
 		if (c == ',')
 		{
 			for (i=0;i<8;i++) {
 				LCD_write_byte(pgm_read_byte(&(font_2x[16][2*i])),0);
 				LCD_write_byte(pgm_read_byte(&(font_2x[16][2*i])),0);
 			}
 			LCD_y_pos(y); 
 			LCD_x_pos(lcd.x_pos+1);
 			for (i=0;i<8;i++) {
 				LCD_write_byte(pgm_read_byte(&(font_2x[16][2*i+1])),0);
 				LCD_write_byte(pgm_read_byte(&(font_2x[16][2*i+1])),0);
 			}
 		}
 		
 		if (c == ' ')
 		{
 			for (i=0;i<8;i++) {
 				LCD_write_byte(pgm_read_byte(&(font_2x[17][2*i])),0);
 				LCD_write_byte(pgm_read_byte(&(font_2x[17][2*i])),0);
 			}
 			LCD_y_pos(y); 
 			LCD_x_pos(lcd.x_pos+1);
 			for (i=0;i<8;i++) {
 				LCD_write_byte(pgm_read_byte(&(font_2x[17][2*i+1])),0);
 				LCD_write_byte(pgm_read_byte(&(font_2x[17][2*i+1])),0);
 			}
 		}
 		
 		if (c == 't')
 		{
 			for (i=0;i<8;i++) {
 				LCD_write_byte(pgm_read_byte(&(font_2x[18][2*i])),0);
 				LCD_write_byte(pgm_read_byte(&(font_2x[18][2*i])),0);
 			}
 			LCD_y_pos(y); 
 			LCD_x_pos(lcd.x_pos+1);
 			for (i=0;i<8;i++) {
 				LCD_write_byte(pgm_read_byte(&(font_2x[18][2*i+1])),0);
 				LCD_write_byte(pgm_read_byte(&(font_2x[18][2*i+1])),0);
 			}
 		}
 		
 		if (c == 'p')
 		{
 			for (i=0;i<8;i++) {
 				LCD_write_byte(pgm_read_byte(&(font_2x[19][2*i])),0);
 				LCD_write_byte(pgm_read_byte(&(font_2x[19][2*i])),0);
 			}
 			LCD_y_pos(y); 
 			LCD_x_pos(lcd.x_pos+1);
 			for (i=0;i<8;i++) {
 				LCD_write_byte(pgm_read_byte(&(font_2x[19][2*i+1])),0);
 				LCD_write_byte(pgm_read_byte(&(font_2x[19][2*i+1])),0);
 			}
 		}
 		
 		if (c == '=')
 		{
 			for (i=0;i<8;i++) {
 				LCD_write_byte(pgm_read_byte(&(font_2x[20][2*i])),0);
 				LCD_write_byte(pgm_read_byte(&(font_2x[20][2*i])),0);
 			}
 			LCD_y_pos(y); 
 			LCD_x_pos(lcd.x_pos+1);
 			for (i=0;i<8;i++) {
 				LCD_write_byte(pgm_read_byte(&(font_2x[20][2*i+1])),0);
 				LCD_write_byte(pgm_read_byte(&(font_2x[20][2*i+1])),0);
 			}
 		}
 		
 		if (c == 'q')
 		{
 			for (i=0;i<8;i++) {
 				LCD_write_byte(pgm_read_byte(&(font_2x[21][2*i])),0);
 				LCD_write_byte(pgm_read_byte(&(font_2x[21][2*i])),0);
 			}
 			LCD_y_pos(y); 
 			LCD_x_pos(lcd.x_pos+1);
 			for (i=0;i<8;i++) {
 				LCD_write_byte(pgm_read_byte(&(font_2x[21][2*i+1])),0);
 				LCD_write_byte(pgm_read_byte(&(font_2x[21][2*i+1])),0);
 			}
 		}
 		if (c == 'q')
 		{
 			for (i=0;i<8;i++) {
 				LCD_write_byte(pgm_read_byte(&(font_2x[22][2*i])),0);
 				LCD_write_byte(pgm_read_byte(&(font_2x[22][2*i])),0);
 			}
 			LCD_y_pos(y); 
 			LCD_x_pos(lcd.x_pos+1);
 			for (i=0;i<8;i++) {
 				LCD_write_byte(pgm_read_byte(&(font_2x[22][2*i+1])),0);
 				LCD_write_byte(pgm_read_byte(&(font_2x[22][2*i+1])),0);
 			}
 		}
 		
 		if (c == 'w')
 		{
 			for (i=0;i<8;i++) {
 				LCD_write_byte(pgm_read_byte(&(font_2x[23][2*i])),0);
 				LCD_write_byte(pgm_read_byte(&(font_2x[23][2*i])),0);
 			}
 			LCD_y_pos(y); 
 			LCD_x_pos(lcd.x_pos+1);
 			for (i=0;i<8;i++) {
 				LCD_write_byte(pgm_read_byte(&(font_2x[23][2*i+1])),0);
 				LCD_write_byte(pgm_read_byte(&(font_2x[23][2*i+1])),0);
 			}
 		}
 		
 		if (c == 'w')
 		{
 			for (i=0;i<8;i++) {
 				LCD_write_byte(pgm_read_byte(&(font_2x[24][2*i])),0);
 				LCD_write_byte(pgm_read_byte(&(font_2x[24][2*i])),0);
 			}
 			LCD_y_pos(y); 
 			LCD_x_pos(lcd.x_pos+1);
 			for (i=0;i<8;i++) {
 				LCD_write_byte(pgm_read_byte(&(font_2x[24][2*i+1])),0);
 				LCD_write_byte(pgm_read_byte(&(font_2x[24][2*i+1])),0);
 			}
 		}
 	}
 	
 	
 	
 	if (lcd.x_pos<LCD_X_MAX)
 	{ LCD_y_pos(y); LCD_x_pos(lcd.x_pos+1); }
 	else
 	{
 		if (lcd.y_pos==0) // right downmost position !
 			LCD_pos_0();
 		else // line feed
 			LCD_x_pos(0);
 	}
 }
 
 
 void LCD_printf_2x(char* str)
 {
 	unsigned int i,len = strlen(str);
 	for(i = 0; i<len; i++)
 	{
 		lcd_put2xc(str[i]);
 	}
 }
*/

void LCD_draw_image (unsigned char x,unsigned char y,char* Pimage)
{
	unsigned char Xpos = lcd.x_pos, Ypos = lcd.y_pos;
	unsigned char x1,y1;
	
	if (Pimage != NULL)
	{	
		char* Pcolumn = Pimage;
		for (x1 = 0; x1 < x; x1++)
		{
			for (y1 = 0; y1 < y; y1++)
			{
				LCD_write_byte(pgm_read_byte(Pcolumn + y1*x), 0);
				//LCD_write_byte(*(Pcolumn + y1*x), 0);
			}
			Pcolumn++;
			LCD_y_pos(Ypos);
			LCD_x_pos(++Xpos);
		}			
	}
	else
	{
		for (x1 = 0; x1 < x; x1++)
		{
			for (y1 = 0; y1 < y; y1++)
			{
				LCD_write_byte(0x00, 0);
			}
			LCD_y_pos(Ypos);
			LCD_x_pos(++Xpos);
		}
	}
}




